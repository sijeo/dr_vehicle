/dts-v1/;
/plugin/;

/ { 
    compatible = "brcm, bcm2835";

    fragment@0 {
        target = <&uart0>;
        __overlay__ {
            status = "okay";

            gnss@0 {
                compatible = "ublox,neo-6m";
            };
        };
    };
};