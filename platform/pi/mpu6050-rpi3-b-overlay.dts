/dts-v1/;
/plugin/;

/{
    compatible = "brcm,bcm2835";

    fragment@0 {
        target = <&i2c1>;
        __overlay__ {
            #address-cells = <1>;
            #size-cells = <0>;
            status = "okay";

            ism330dlctr@6a {
                compatible = "stm,ism330dlctr";
                reg = <0x6a>;

                /* INT1 wired to Pi GPIO 25. Trigger type second cell = 1
                 * (IRQ_TYPE_EDGE_RISING). Previously encoded as 2 which
                 * is falling edge — that was inconsistent with the ST
                 * default INT1 polarity (active-high) so DRDY IRQs were
                 * never firing. */
                interrupt-parent = <&gpio>;
                interrupts = <25 1>;   /* IRQ_TYPE_EDGE_RISING */

                // Optional defaults (match your driver's DT parsing)
                st,accel-fsr-g = <8>;   //2/4/8/16 g
                st,gyro-fsr-dps = <2000>;    // 250/500/1000/2000 dps
                st,odr-hz = <200>;          //effective ODR with DLPF = On 
            };
        };
    };
};